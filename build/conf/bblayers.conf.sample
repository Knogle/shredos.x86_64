## build/conf/bblayers.conf.sample
```bitbake
# .._BBLAYERS_CONF_VERSION is increased each time build/conf/bblayers.conf
# changes incompatibly
POKY_BBLAYERS_CONF_VERSION = "2"

BBPATH = "${TOPDIR}"
BBFILES ?= ""

BBLAYERS ?= " \
  /workspace/../meta \
  /workspace/../meta-.. \
  /workspace/../meta-yocto-bsp \
  /workspace/../meta-shredos \
  /workspace/../meta-openembedded/meta-oe \
  /workspace/../meta-openembedded/meta-filesystems \
  /workspace/../meta-openembedded/meta-networking \
  /workspace/../meta-openembedded/meta-python \
  "
```

## meta-shredos/conf/layer.conf
```bitbake
# We have a conf and classes directory, add to BBPATH
BBPATH .= ":${LAYERDIR}"

# We have recipes-* directories, add to BBFILES
BBFILES += "${LAYERDIR}/recipes-*/*/*.bb \
            ${LAYERDIR}/recipes-*/*/*.bbappend"

BBFILE_COLLECTIONS += "meta-shredos"
BBFILE_PATTERN_meta-shredos = "^${LAYERDIR}/"
BBFILE_PRIORITY_meta-shredos = "6"

LAYERDEPENDS_meta-shredos = "core"
LAYERSERIES_COMPAT_meta-shredos = "styhead"
```

## meta-shredos/conf/machine/shredos-machine.conf
```bitbake
# shredos-machine.conf
# require conf/machine/include/tune-x86_64.inc

MACHINE_FEATURES += "keyboard screen"

SERIAL_CONSOLE = "115200 ttyS0"
```

## package/nwipe/Config.in
```kconfig
config BR2_PACKAGE_NWIPE
	bool "nwipe"
	select BR2_PACKAGE_NCURSES
	select BR2_PACKAGE_PARTED
	select BR2_PACKAGE_COREUTILS
	select BR2_PACKAGE_DMIDECODE
	select BR2_PACKAGE_LIBCONFIG
	help
	  NWipe – secure disk wiping tool (fork of Darik's Boot and Nuke).

if BR2_PACKAGE_NWIPE

config BR2_PACKAGE_NWIPE_SITE
	string "nwipe Git repository URL"
	default "https://github.com/martijnvanbrummelen/nwipe.git"
	help
	  Git repository used to fetch the nwipe sources.
	  This can be changed to point to a custom fork, e.g.:
	    - https://github.com/youruser/nwipe.git
	    - git@github.com:youruser/nwipe.git

choice
	prompt "nwipe version"
	default BR2_PACKAGE_NWIPE_VERSION_STABLE
	help
	  Select which nwipe version (Git ref) should be built.

config BR2_PACKAGE_NWIPE_VERSION_STABLE
	bool "Stable commit (051e1aa)"
	help
	  Use the previously hard-coded commit (051e1aa) as a stable baseline.

config BR2_PACKAGE_NWIPE_VERSION_MASTER
	bool "Upstream master branch"
	help
	  Always build from the current upstream master branch.

config BR2_PACKAGE_NWIPE_VERSION_GIT_REVISION
	bool "Git revision"
	help
	  Use a user-specified Git revision (commit SHA-1 or branch name).

endchoice

config BR2_PACKAGE_NWIPE_GIT_REVISION
	string "Insert a commit's SHA-1 or a branch name"
	depends on BR2_PACKAGE_NWIPE_VERSION_GIT_REVISION
	help
	  When 'Git revision' is selected above, this string is passed as the
	  Git ref to check out. Examples:
	    - origin/master
	    - feature/my-branch
	    - 051e1aa

endif

comment "nwipe"
```
